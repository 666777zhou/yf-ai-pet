## firmware/sdkconfig.defaults
```kconfig
# ESP32-S3 with 16MB Flash and 8MB Octal PSRAM
CONFIG_ESPTOOLPY_FLASHSIZE_16MB=y
CONFIG_ESPTOOLPY_FLASHMODE_QIO=y
CONFIG_ESPTOOLPY_FLASHFREQ_80M=y

CONFIG_ESP_DEFAULT_CPU_FREQ_MHZ_240=y

# PSRAM (Octal, 8MB)
CONFIG_SPIRAM=y
CONFIG_SPIRAM_MODE_OCT=y
CONFIG_SPIRAM_SPEED_80M=y
CONFIG_SPIRAM_MALLOC_ALWAYSINTERNAL=512
CONFIG_SPIRAM_MALLOC_RESERVE_INTERNAL=65536
CONFIG_MBEDTLS_EXTERNAL_MEM_ALLOC=y

# Cache config for ESP32-S3
CONFIG_ESP32S3_INSTRUCTION_CACHE_32KB=y
CONFIG_ESP32S3_DATA_CACHE_64KB=y
CONFIG_ESP32S3_DATA_CACHE_LINE_64B=y

# WiFi
CONFIG_ESP_WIFI_STATIC_RX_BUFFER_NUM=16
CONFIG_ESP_WIFI_DYNAMIC_RX_BUFFER_NUM=64
CONFIG_ESP_WIFI_STATIC_TX_BUFFER_NUM=16
CONFIG_ESP_WIFI_DYNAMIC_TX_BUFFER_NUM=64

# Event loop task stack
CONFIG_ESP_SYSTEM_EVENT_TASK_STACK_SIZE=4096

# Main task stack
CONFIG_ESP_MAIN_TASK_STACK_SIZE=8192

# Use custom partition table (OTA dual-partition, 16MB Flash)
CONFIG_PARTITION_TABLE_CUSTOM=y
CONFIG_PARTITION_TABLE_CUSTOM_FILENAME="partitions.csv"

# LVGL 9 — 16-bit color depth (RGB565) matching ST7789
CONFIG_LV_COLOR_DEPTH_16=y
# Memory pool: use system malloc (defer to ESP-IDF heap)
CONFIG_LV_MEM_CUSTOM=y
CONFIG_LV_MEM_CUSTOM_INCLUDE="stdlib.h"
CONFIG_LV_MEM_CUSTOM_ALLOC="malloc"
CONFIG_LV_MEM_CUSTOM_FREE="free"
CONFIG_LV_MEM_CUSTOM_REALLOC="realloc"
# Disable unused features to save flash
CONFIG_LV_USE_LOG=n
CONFIG_LV_USE_PERF_MONITOR=n
CONFIG_LV_USE_DEMO_WIDGETS=n
CONFIG_LV_USE_DEMO_BENCHMARK=n
CONFIG_LV_USE_DEMO_STRESS=n
CONFIG_LV_USE_DEMO_KEYPAD_AND_ENCODER=n
CONFIG_LV_USE_DEMO_MUSIC=n
```
